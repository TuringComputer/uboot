## board/quanta/mx53quanta/Kconfig
```kconfig
if TARGET_MX53QUANTA

config SYS_BOARD
	default "mx53quanta"

config SYS_VENDOR
	default "quanta"

config SYS_SOC
	default "mx5"

config SYS_CONFIG_NAME
	default "mx53quanta"

endif
```

## board/quanta/mx6quanta/Kconfig
```kconfig
if TARGET_MX6QUANTA

config SYS_BOARD
	default "mx6quanta"

config SYS_SOC
	default "mx6"

config SYS_VENDOR
	default "quanta"

config SYS_CONFIG_NAME
	default "mx6quanta"

endif
```

## board/turing/mx53turing/Kconfig
```kconfig
if TARGET_MX53TURING

config SYS_BOARD
	default "mx53turing"

config SYS_VENDOR
	default "turing"

config SYS_SOC
	default "mx5"

config SYS_CONFIG_NAME
	default "mx53turing"

endif
```

## board/turing/mx6turing/Kconfig
```kconfig
if TARGET_MX6TURING

config SYS_BOARD
	default "mx6turing"

config SYS_SOC
	default "mx6"

config SYS_VENDOR
	default "turing"

config SYS_CONFIG_NAME
	default "mx6turing"

endif
```

## board/turing/mx6ulturing/Kconfig
```kconfig
if TARGET_MX6ULTURING

config SYS_BOARD
	default "mx6ulturing"

config SYS_SOC
	default "mx6"

config SYS_VENDOR
	default "turing"

config SYS_CONFIG_NAME
	default "mx6ulturing"

endif
```

## configs/mx53quanta_defconfig
```kconfig
CONFIG_SYS_EXTRA_OPTIONS="IMX_CONFIG=board/quanta/mx53quanta/imximage.cfg"
CONFIG_ARM=y
CONFIG_TARGET_MX53QUANTA=y
```

## configs/mx53turing_defconfig
```kconfig
CONFIG_SYS_EXTRA_OPTIONS="IMX_CONFIG=board/turing/mx53turing/imximage.cfg"
CONFIG_ARM=y
CONFIG_TARGET_MX53TURING=y
```

## configs/mx6turing_smart_android_defconfig
```kconfig
CONFIG_SPL=y
CONFIG_SYS_EXTRA_OPTIONS="IMX_CONFIG=arch/arm/imx-common/spl_sd.cfg,SPL,MX6QDL,ANDROID_SUPPORT,TURING_SMART_VARIANT"
CONFIG_ARM=y
CONFIG_TARGET_MX6TURING=y
CONFIG_DM=y
CONFIG_DM_THERMAL=y
CONFIG_TURING_SMART_VARIANT=y
```

## configs/mx6ulturing_defconfig
```kconfig
CONFIG_ARM=y
CONFIG_ARCH_MX6=y
CONFIG_TARGET_MX6ULTURING=y
CONFIG_SPL=y
CONFIG_SPL_DMA_SUPPORT=y
CONFIG_SPL_EXT_SUPPORT=y
CONFIG_SPL_I2C_SUPPORT=y
CONFIG_SPL_GPIO_SUPPORT=y
CONFIG_SPL_LIBCOMMON_SUPPORT=y
CONFIG_SPL_LIBGENERIC_SUPPORT=y
CONFIG_SPL_MMC_SUPPORT=y
CONFIG_SPL_NAND_SUPPORT=y
CONFIG_SPL_SERIAL_SUPPORT=y
CONFIG_SPL_LIBDISK_SUPPORT=y
CONFIG_SPL_WATCHDOG_SUPPORT=y
# CONFIG_VIDEO is not set
CONFIG_SYS_EXTRA_OPTIONS="IMX_CONFIG=arch/arm/imx-common/spl_sd.cfg,SPL,MX6UL"
CONFIG_BOOTDELAY=3
# CONFIG_CONSOLE_MUX is not set
CONFIG_SYS_CONSOLE_IS_IN_ENV=y
CONFIG_SYS_CONSOLE_OVERWRITE_ROUTINE=y
CONFIG_BOARD_EARLY_INIT_F=y
CONFIG_HUSH_PARSER=y
CONFIG_CMD_BOOTZ=y
# CONFIG_CMD_IMLS is not set
CONFIG_CMD_MEMTEST=y
CONFIG_CMD_MMC=y
CONFIG_CMD_NAND=y
CONFIG_CMD_I2C=y
CONFIG_CMD_USB=y
CONFIG_CMD_GPIO=y
CONFIG_CMD_DHCP=y
CONFIG_CMD_PING=y
CONFIG_CMD_CACHE=y
CONFIG_CMD_EXT2=y
CONFIG_CMD_EXT4=y
CONFIG_CMD_EXT4_WRITE=y
CONFIG_CMD_FAT=y
CONFIG_CMD_FS_GENERIC=y
CONFIG_CMD_UBI=y
CONFIG_NAND_MXS=y
# CONFIG_SPI_FLASH is not set
# CONFIG_SPI_FLASH_BAR is not set
# CONFIG_SPI_FLASH_STMICRO is not set
# CONFIG_FSL_QSPI is not set
# CONFIG_CMD_SF is not set
CONFIG_USB=y
CONFIG_USB_STORAGE=y
CONFIG_USB_GADGET=y
CONFIG_CI_UDC=y
CONFIG_USB_GADGET_DOWNLOAD=y
CONFIG_G_DNL_MANUFACTURER="FSL"
CONFIG_G_DNL_VENDOR_NUM=0x0525
CONFIG_G_DNL_PRODUCT_NUM=0xa4a5
CONFIG_OF_LIBFDT=y
CONFIG_PINCTRL=y
CONFIG_PINCTRL_IMX6=y
```
